#include "daisy-qrd.dtsi"
#include "daisy-general.dtsi"
#include "daisy-audio.dtsi"
#include "daisy-camera.dtsi"
#include "daisy-mdss.dtsi"
#include "daisy-pinctrl.dtsi"
#include "daisy-pm.dtsi"
#include "daisy-regulator.dtsi"
#include "general-clk.dtsi"
#include "overlay.dtsi"