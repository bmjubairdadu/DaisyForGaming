## drivers/net/ethernet/mellanox/mlx4/Kconfig.rej
```kconfig
--- drivers/net/ethernet/mellanox/mlx4/Kconfig
+++ drivers/net/ethernet/mellanox/mlx4/Kconfig
@@ -5,7 +5,7 @@
 config MLX4_EN
 	tristate "Mellanox Technologies 1/10/40Gbit Ethernet support"
 	depends on MAY_USE_DEVLINK
-	depends on PCI
+	depends on PCI && NETDEVICES && ETHERNET && INET
 	select MLX4_CORE
 	select PTP_1588_CLOCK
 	---help---
```

## drivers/net/ethernet/stmicro/stmmac/Kconfig.rej
```kconfig
--- drivers/net/ethernet/stmicro/stmmac/Kconfig
+++ drivers/net/ethernet/stmicro/stmmac/Kconfig
@@ -83,7 +83,7 @@ config DWMAC_ROCKCHIP
 config DWMAC_SOCFPGA
 	tristate "SOCFPGA dwmac support"
 	default ARCH_SOCFPGA
-	depends on OF && (ARCH_SOCFPGA || COMPILE_TEST)
+	depends on OF && (ARCH_SOCFPGA || ARCH_STRATIX10 || COMPILE_TEST)
 	select MFD_SYSCON
 	help
 	  Support for ethernet controller on Altera SOCFPGA
```

## drivers/net/fddi/Kconfig.rej
```kconfig
--- drivers/net/fddi/Kconfig
+++ drivers/net/fddi/Kconfig
@@ -28,17 +28,20 @@ config DEFXX
 
 config DEFXX_MMIO
 	bool
-	prompt "Use MMIO instead of PIO" if PCI || EISA
+	prompt "Use MMIO instead of IOP" if PCI || EISA
 	depends on DEFXX
-	default n if PCI || EISA
+	default n if EISA
 	default y
 	---help---
 	  This instructs the driver to use EISA or PCI memory-mapped I/O
-	  (MMIO) as appropriate instead of programmed I/O ports (PIO).
+	  (MMIO) as appropriate instead of programmed I/O ports (IOP).
 	  Enabling this gives an improvement in processing time in parts
-	  of the driver, but it may cause problems with EISA (DEFEA)
-	  adapters.  TURBOchannel does not have the concept of I/O ports,
-	  so MMIO is always used for these (DEFTA) adapters.
+	  of the driver, but it requires a memory window to be configured
+	  for EISA (DEFEA) adapters that may not always be available.
+	  Conversely some PCIe host bridges do not support IOP, so MMIO
+	  may be required to access PCI (DEFPA) adapters on downstream PCI
+	  buses with some systems.  TURBOchannel does not have the concept
+	  of I/O ports, so MMIO is always used for these (DEFTA) adapters.
 
 	  If unsure, say N.
 
```

## drivers/net/usb/Kconfig.rej
```kconfig
--- drivers/net/usb/Kconfig
+++ drivers/net/usb/Kconfig
@@ -98,6 +98,10 @@ config USB_RTL8150
 config USB_RTL8152
 	tristate "Realtek RTL8152/RTL8153 Based USB Ethernet Adapters"
 	select MII
+	select CRC32
+	select CRYPTO
+	select CRYPTO_HASH
+	select CRYPTO_SHA256
 	help
 	  This option adds support for Realtek RTL8152 based USB 2.0
 	  10/100 Ethernet adapters and RTL8153 based USB 3.0 10/100/1000
@@ -364,7 +368,7 @@ config USB_NET_NET1080
 	  optionally with LEDs that indicate traffic
 
 config USB_NET_PLUSB
-	tristate "Prolific PL-2301/2302/25A1 based cables"
+	tristate "Prolific PL-2301/2302/25A1/27A1 based cables"
 	# if the handshake/init/reset problems, from original 'plusb',
 	# are ever resolved ... then remove "experimental"
 	depends on USB_USBNET
```

## drivers/net/wireless/ath/carl9170/Kconfig.rej
```kconfig
--- drivers/net/wireless/ath/carl9170/Kconfig
+++ drivers/net/wireless/ath/carl9170/Kconfig
@@ -15,13 +15,11 @@ config CARL9170
 
 config CARL9170_LEDS
 	bool "SoftLED Support"
-	depends on CARL9170
-	select MAC80211_LEDS
-	select LEDS_CLASS
-	select NEW_LEDS
 	default y
+	depends on CARL9170
+	depends on MAC80211_LEDS
 	help
-	  This option is necessary, if you want your device' LEDs to blink
+	  This option is necessary, if you want your device's LEDs to blink.
 
 	  Say Y, unless you need the LEDs for firmware debugging.
 
```

## drivers/phy/Kconfig.rej
```kconfig
--- drivers/phy/Kconfig
+++ drivers/phy/Kconfig
@@ -456,6 +456,7 @@ config PHY_QCOM_UFS
 config PHY_TUSB1210
 	tristate "TI TUSB1210 ULPI PHY module"
 	depends on USB_ULPI_BUS
+	depends on EXTCON || !EXTCON # if EXTCON=m, this cannot be built-in
 	select GENERIC_PHY
 	help
 	  Support for TI TUSB1210 USB ULPI PHY.
```

## drivers/pinctrl/Kconfig.rej
```kconfig
--- drivers/pinctrl/Kconfig
+++ drivers/pinctrl/Kconfig
@@ -26,7 +26,8 @@ config DEBUG_PINCTRL
 
 config PINCTRL_ADI2
 	bool "ADI pin controller driver"
-	depends on BLACKFIN
+	depends on (BF54x || BF60x)
+	depends on !GPIO_ADI
 	select PINMUX
 	select IRQ_DOMAIN
 	help
@@ -82,6 +83,7 @@ config PINCTRL_AMD
 	tristate "AMD GPIO pin control"
 	depends on GPIOLIB
 	select GPIOLIB_IRQCHIP
+	select PINMUX
 	select PINCONF
 	select GENERIC_PINCONF
 	help
```

## drivers/platform/dfg/Kconfig
```kconfig
#
# DaisyForGaming control interface
#

config DFG
	bool "DaisyForGaming control interface (DFG)"
	depends on ARCH_QCOM && SYSFS && CPU_FREQ && BLOCK && THERMAL
	help
	  Exposes a runtime control interface for the DaisyForGaming
	  kernel at /sys/devices/platform/dfg/:

	    profile          - "performance" | "balanced" | "battery"
	    cpu_min_freq     - per-policy minimum frequency (kHz)
	    cpu_max_freq     - per-policy maximum frequency (kHz)
	    governor         - cpufreq governor, applied to all policies
	    io_scheduler     - block I/O elevator of the boot disk
	    thermal_override - bool; allow the performance profile past
	                       the soft thermal limit (the hard limit
	                       always applies)
	    boost_ms         - one-shot frequency boost duration (ms)
	    deep_idle        - bool; disable deep cpuidle states
	    thermal_events   - ring buffer of the last thermal events
	    thermal_limits   - current soft/hard limits and thermal state
	    vendor_compat    - result of the vendor/platform runtime check

	  Writes require root (or the DFG-Controller app under the
	  shipped SELinux policy). All tunables keep their defaults if
	  the interface is disabled.

if DFG

config DFG_DEFAULT_PERF
	bool "Apply the performance profile by default at boot"
	default y
	help
	  Boots with the "performance" profile (see DFG_PERF_*) applied
	  from kernel init, before userspace starts. Disable for a
	  "balanced" boot default; the profile can always be switched at
	  runtime through /sys/devices/platform/dfg/profile.

config DFG_PERF_DISABLE_DEEP_IDLE
	bool "Disable deep CPU idle states in performance mode"
	depends on CPU_IDLE
	default n
	help
	  Disables all cpuidle states on every CPU when the performance
	  profile is applied at boot. Removes deep-sleep wake latency
	  jank at the cost of battery life. Can be toggled at runtime
	  via /sys/devices/platform/dfg/deep_idle.

config DFG_PERF_GOVERNOR
	string "Performance profile cpufreq governor"
	default "schedutil"
	help
	  Governor applied when the "performance" profile is selected.
	  Any registered governor name can be used at runtime.

config DFG_BAL_GOVERNOR
	string "Balanced profile cpufreq governor"
	default "schedutil"

config DFG_BAT_GOVERNOR
	string "Battery profile cpufreq governor"
	default "schedutil"

config DFG_PERF_IOSCHED
	string "Performance profile I/O scheduler"
	default "noop"
	help
	  I/O scheduler applied to the boot disk with the "performance"
	  profile. noop/mq-deadline minimize request latency; bfq/cfq
	  trade latency for fairness.

config DFG_BAL_IOSCHED
	string "Balanced profile I/O scheduler"
	default "bfq"

config DFG_BAT_IOSCHED
	string "Battery profile I/O scheduler"
	default "cfq"

config DFG_PERF_MIN_FREQ
	int "Performance profile minimum frequency (kHz)"
	default 1401600
	help
	  msm8953 boot-time baseline: 1401600 kHz keeps all cores above
	  the freq/voltage cliff where frame pacing jank appears.

config DFG_PERF_MAX_FREQ
	int "Performance profile maximum frequency (kHz)"
	default 2016000

config DFG_BAL_MIN_FREQ
	int "Balanced profile minimum frequency (kHz)"
	default 652800

config DFG_BAL_MAX_FREQ
	int "Balanced profile maximum frequency (kHz)"
	default 2016000

config DFG_BAT_MIN_FREQ
	int "Battery profile minimum frequency (kHz)"
	default 300000

config DFG_BAT_MAX_FREQ
	int "Battery profile maximum frequency (kHz)"
	default 1401600

config DFG_THERM_SOFT_LIMIT
	int "Soft thermal limit (milli-Celsius)"
	default 50000
	help
	  Above this temperature the DFG watchdog caps the CPU frequency
	  at DFG_THERMAL_SAFE_FREQ unless thermal_override is set.

config DFG_THERM_HARD_LIMIT
	int "Hard thermal limit (milli-Celsius)"
	default 60000
	help
	  Above this temperature the DFG watchdog always caps the CPU
	  frequency at DFG_THERMAL_SAFE_FREQ/MIN and resets
	  thermal_override. The hard limit can never be disabled from
	  userspace; the kernel thermal framework (tsens) remains fully
	  active on top of this.

config DFG_THERM_HYSTERESIS
	int "Thermal recovery hysteresis (milli-Celsius)"
	default 3000

config DFG_THERMAL_SAFE_FREQ
	int "Thermally safe maximum frequency (kHz)"
	default 1401600

config DFG_THERMAL_SAFE_MIN_FREQ
	int "Thermally safe minimum frequency (kHz)"
	default 652800

config DFG_THERMAL_SAMPLE_MS
	int "Thermal watchdog sample period (ms)"
	default 2000

config DFG_BOOT_BOOST_MS
	int "Boot-time frequency boost duration (ms)"
	default 0
	help
	  Duration of a full-frequency boost applied shortly after boot
	  when the default profile is performance. 0 disables.

endif # DFG
```

## drivers/platform/x86/Kconfig.rej
```kconfig
--- drivers/platform/x86/Kconfig
+++ drivers/platform/x86/Kconfig
@@ -945,6 +945,7 @@ config INTEL_OAKTRAIL
 config SAMSUNG_Q10
 	tristate "Samsung Q10 Extras"
 	depends on ACPI
+	depends on BACKLIGHT_LCD_SUPPORT
 	select BACKLIGHT_CLASS_DEVICE
 	---help---
 	  This driver provides support for backlight control on Samsung Q10
```

## drivers/power/reset/Kconfig.rej
```kconfig
--- drivers/power/reset/Kconfig
+++ drivers/power/reset/Kconfig
@@ -32,7 +32,7 @@ config POWER_RESET_AT91_RESET
 
 config POWER_RESET_AT91_SAMA5D2_SHDWC
 	tristate "Atmel AT91 SAMA5D2-Compatible shutdown controller driver"
-	depends on ARCH_AT91 || COMPILE_TEST
+	depends on ARCH_AT91
 	default SOC_SAMA5
 	help
 	  This driver supports the alternate shutdown controller for some Atmel
```

## drivers/power/supply/Kconfig.rej
```kconfig
--- drivers/power/supply/Kconfig
+++ drivers/power/supply/Kconfig
@@ -424,7 +424,7 @@ config CHARGER_BQ24257
 	tristate "TI BQ24250/24251/24257 battery charger driver"
 	depends on I2C
 	depends on GPIOLIB || COMPILE_TEST
-	depends on REGMAP_I2C
+	select REGMAP_I2C
 	help
 	  Say Y to enable support for the TI BQ24250, BQ24251, and BQ24257 battery
 	  chargers.
@@ -490,7 +490,8 @@ config BATTERY_GOLDFISH
 
 config BATTERY_RT5033
 	tristate "RT5033 fuel gauge support"
-	depends on MFD_RT5033
+	depends on I2C
+	select REGMAP_I2C
 	help
 	  This adds support for battery fuel gauge in Richtek RT5033 PMIC.
 	  The fuelgauge calculates and determines the battery state of charge
```

## drivers/rapidio/Kconfig.rej
```kconfig
--- drivers/rapidio/Kconfig
+++ drivers/rapidio/Kconfig
@@ -25,7 +25,7 @@ config RAPIDIO_ENABLE_RX_TX_PORTS
 config RAPIDIO_DMA_ENGINE
 	bool "DMA Engine support for RapidIO"
 	depends on RAPIDIO
-	select DMADEVICES
+	depends on DMADEVICES
 	select DMA_ENGINE
 	help
 	  Say Y here if you want to use DMA Engine frameork for RapidIO data
```

## drivers/remoteproc/Kconfig.rej
```kconfig
--- drivers/remoteproc/Kconfig
+++ drivers/remoteproc/Kconfig
@@ -91,17 +91,12 @@ config QCOM_Q6V5_PIL
 	  Say y here to support the Qualcomm Peripherial Image Loader for the
 	  Hexagon V5 based remote processors.
 
-config QCOM_WCNSS_IRIS
-	tristate
-	depends on OF && ARCH_QCOM
-
 config QCOM_WCNSS_PIL
 	tristate "Qualcomm WCNSS Peripheral Image Loader"
 	depends on OF && ARCH_QCOM
 	depends on QCOM_SMEM
 	select QCOM_MDT_LOADER
 	select QCOM_SCM
-	select QCOM_WCNSS_IRIS
 	select REMOTEPROC
 	help
 	  Say y here to support the Peripheral Image Loader for the Qualcomm
```

## drivers/rtc/Kconfig.rej
```kconfig
--- drivers/rtc/Kconfig
+++ drivers/rtc/Kconfig
@@ -304,6 +304,7 @@ config RTC_DRV_MAX6900
 config RTC_DRV_MAX8907
 	tristate "Maxim MAX8907"
 	depends on MFD_MAX8907
+	select REGMAP_IRQ
 	help
 	  If you say yes here you will get support for the
 	  RTC of Maxim MAX8907 PMIC.
@@ -1432,7 +1433,7 @@ config RTC_DRV_SUN4V
 	  based RTC on SUN4V systems.
 
 config RTC_DRV_SUN6I
-	tristate "Allwinner A31 RTC"
+	bool "Allwinner A31 RTC"
 	default MACH_SUN6I || MACH_SUN8I || COMPILE_TEST
 	depends on ARCH_SUNXI
 	help
```

## drivers/scsi/Kconfig.rej
```kconfig
--- drivers/scsi/Kconfig
+++ drivers/scsi/Kconfig
@@ -986,7 +986,7 @@ config SCSI_SNI_53C710
 
 config 53C700_LE_ON_BE
 	bool
-	depends on SCSI_LASI700
+	depends on SCSI_LASI700 || SCSI_SNI_53C710
 	default y
 
 config SCSI_STEX
@@ -1497,7 +1497,7 @@ config ATARI_SCSI
 
 config MAC_SCSI
 	tristate "Macintosh NCR5380 SCSI"
-	depends on MAC && SCSI=y
+	depends on MAC && SCSI
 	select SCSI_SPI_ATTRS
 	help
 	  This is the NCR 5380 SCSI controller included on most of the 68030
```

## drivers/thermal/Kconfig.rej
```kconfig
--- drivers/thermal/Kconfig
+++ drivers/thermal/Kconfig
@@ -316,7 +316,7 @@ config X86_PKG_TEMP_THERMAL
 
 config INTEL_SOC_DTS_IOSF_CORE
 	tristate
-	depends on X86
+	depends on X86 && PCI
 	select IOSF_MBI
 	help
 	  This is becoming a common feature for Intel SoCs to expose the additional
@@ -326,7 +326,7 @@ config INTEL_SOC_DTS_IOSF_CORE
 
 config INTEL_SOC_DTS_THERMAL
 	tristate "Intel SoCs DTS thermal driver"
-	depends on X86
+	depends on X86 && PCI
 	select INTEL_SOC_DTS_IOSF_CORE
 	select THERMAL_WRITABLE_TRIPS
 	help
```

## drivers/tty/serial/Kconfig.rej
```kconfig
--- drivers/tty/serial/Kconfig
+++ drivers/tty/serial/Kconfig
@@ -9,6 +9,7 @@ menu "Serial drivers"
 
 config SERIAL_EARLYCON
 	bool
+	depends on SERIAL_CORE
 	help
 	  Support for early consoles with the earlycon parameter. This enables
 	  the console before standard serial driver is probed. The console is
```

## drivers/usb/Kconfig.rej
```kconfig
--- drivers/usb/Kconfig
+++ drivers/usb/Kconfig
@@ -19,6 +19,14 @@ config USB_EHCI_BIG_ENDIAN_MMIO
 config USB_EHCI_BIG_ENDIAN_DESC
 	bool
 
+config USB_UHCI_BIG_ENDIAN_MMIO
+	bool
+	default y if SPARC_LEON
+
+config USB_UHCI_BIG_ENDIAN_DESC
+	bool
+	default y if SPARC_LEON
+
 menuconfig USB_SUPPORT
 	bool "USB support"
 	depends on HAS_IOMEM
@@ -152,8 +160,7 @@ source "drivers/usb/gadget/Kconfig"
 
 config USB_LED_TRIG
 	bool "USB LED Triggers"
-	depends on LEDS_CLASS && LEDS_TRIGGERS
-	select USB_COMMON
+	depends on LEDS_CLASS && USB_COMMON && LEDS_TRIGGERS
 	help
 	  This option adds LED triggers for USB host and/or gadget activity.
 
```

## drivers/usb/gadget/Kconfig.rej
```kconfig
--- drivers/usb/gadget/Kconfig
+++ drivers/usb/gadget/Kconfig
@@ -258,6 +258,7 @@ config USB_CONFIGFS_NCM
 	depends on NET
 	select USB_U_ETHER
 	select USB_F_NCM
+	select CRC32
 	help
 	  NCM is an advanced protocol for Ethernet encapsulation, allows
 	  grouping of several ethernet frames into one USB transfer and
@@ -307,6 +308,7 @@ config USB_CONFIGFS_EEM
 	depends on NET
 	select USB_U_ETHER
 	select USB_F_EEM
+	select CRC32
 	help
 	  CDC EEM is a newer USB standard that is somewhat simpler than CDC ECM
 	  and therefore can be supported by more hardware.  Technically ECM and
@@ -460,6 +462,7 @@ config USB_CONFIGFS_F_TCM
 choice
 	tristate "USB Gadget Drivers"
 	default USB_ETH
+	optional
 	help
 	  A Linux "Gadget Driver" talks to the USB Peripheral Controller
 	  driver through the abstract "gadget" API.  Some other operating
```

## drivers/usb/gadget/udc/Kconfig.rej
```kconfig
--- drivers/usb/gadget/udc/Kconfig
+++ drivers/usb/gadget/udc/Kconfig
@@ -278,6 +278,7 @@ config USB_AMD5536UDC
 config USB_FSL_QE
 	tristate "Freescale QE/CPM USB Device Controller"
 	depends on FSL_SOC && (QUICC_ENGINE || CPM)
+	depends on !64BIT || BROKEN
 	help
 	   Some of Freescale PowerPC processors have a Full Speed
 	   QE/CPM2 USB controller, which support device mode with 4
```
